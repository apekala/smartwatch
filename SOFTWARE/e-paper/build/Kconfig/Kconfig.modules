## SOFTWARE/e-paper/build/Kconfig/Kconfig.modules
```kconfig
menu "nrf (D:/aplikacje/nRF/v2.6.0/nrf)"
osource "D:/aplikacje/nRF/v2.6.0/nrf/Kconfig.nrf"
config ZEPHYR_NRF_MODULE
	bool
	default y
endmenu
menu "hostap (D:/aplikacje/nRF/v2.6.0/modules/lib/hostap)"
osource "$(ZEPHYR_HOSTAP_KCONFIG)"
config ZEPHYR_HOSTAP_MODULE
	bool
	default y
endmenu
config ZEPHYR_MCUBOOT_MODULE
   bool
   default y
menu "mbedtls (D:/aplikacje/nRF/v2.6.0/modules/crypto/mbedtls)"
osource "$(ZEPHYR_MBEDTLS_KCONFIG)"
config ZEPHYR_MBEDTLS_MODULE
	bool
	default y
endmenu
menu "trusted-firmware-m (D:/aplikacje/nRF/v2.6.0/modules/tee/tf-m/trusted-firmware-m)"
osource "$(ZEPHYR_TRUSTED_FIRMWARE_M_KCONFIG)"
config ZEPHYR_TRUSTED_FIRMWARE_M_MODULE
	bool
	default y
endmenu
config ZEPHYR_PSA_ARCH_TESTS_MODULE
   bool
   default y
menu "cjson (D:/aplikacje/nRF/v2.6.0/modules/lib/cjson)"
osource "$(ZEPHYR_CJSON_KCONFIG)"
config ZEPHYR_CJSON_MODULE
	bool
	default y
endmenu
menu "azure-sdk-for-c (D:/aplikacje/nRF/v2.6.0/modules/lib/azure-sdk-for-c)"
osource "$(ZEPHYR_AZURE_SDK_FOR_C_KCONFIG)"
config ZEPHYR_AZURE_SDK_FOR_C_MODULE
	bool
	default y
endmenu
menu "cirrus-logic (D:/aplikacje/nRF/v2.6.0/modules/hal/cirrus-logic)"
osource "D:/aplikacje/nRF/v2.6.0/modules/hal/cirrus-logic/Kconfig"
config ZEPHYR_CIRRUS_LOGIC_MODULE
	bool
	default y
endmenu
menu "openthread (D:/aplikacje/nRF/v2.6.0/modules/lib/openthread)"
osource "$(ZEPHYR_OPENTHREAD_KCONFIG)"
config ZEPHYR_OPENTHREAD_MODULE
	bool
	default y
endmenu
menu "memfault-firmware-sdk (D:/aplikacje/nRF/v2.6.0/modules/lib/memfault-firmware-sdk)"
osource "D:/aplikacje/nRF/v2.6.0/modules/lib/memfault-firmware-sdk/ports/zephyr/Kconfig"
config ZEPHYR_MEMFAULT_FIRMWARE_SDK_MODULE
	bool
	default y
endmenu
menu "canopennode (D:/aplikacje/nRF/v2.6.0/modules/lib/canopennode)"
osource "$(ZEPHYR_CANOPENNODE_KCONFIG)"
config ZEPHYR_CANOPENNODE_MODULE
	bool
	default y
endmenu
menu "chre (D:/aplikacje/nRF/v2.6.0/modules/lib/chre)"
osource "D:/aplikacje/nRF/v2.6.0/modules/lib/chre/platform/zephyr/Kconfig"
config ZEPHYR_CHRE_MODULE
	bool
	default y
endmenu
menu "lz4 (D:/aplikacje/nRF/v2.6.0/modules/lib/lz4)"
osource "$(ZEPHYR_LZ4_KCONFIG)"
config ZEPHYR_LZ4_MODULE
	bool
	default y
endmenu
menu "nanopb (D:/aplikacje/nRF/v2.6.0/modules/lib/nanopb)"
osource "$(ZEPHYR_NANOPB_KCONFIG)"
config ZEPHYR_NANOPB_MODULE
	bool
	default y
endmenu
config ZEPHYR_TF_M_TESTS_MODULE
   bool
   default y
menu "zscilib (D:/aplikacje/nRF/v2.6.0/modules/lib/zscilib)"
osource "D:/aplikacje/nRF/v2.6.0/modules/lib/zscilib/Kconfig.zscilib"
config ZEPHYR_ZSCILIB_MODULE
	bool
	default y
endmenu
menu "cmsis (D:/aplikacje/nRF/v2.6.0/modules/hal/cmsis)"
osource "$(ZEPHYR_CMSIS_KCONFIG)"
config ZEPHYR_CMSIS_MODULE
	bool
	default y
endmenu
menu "cmsis-dsp (D:/aplikacje/nRF/v2.6.0/modules/lib/cmsis-dsp)"
osource "$(ZEPHYR_CMSIS_DSP_KCONFIG)"
config ZEPHYR_CMSIS_DSP_MODULE
	bool
	default y
endmenu
menu "cmsis-nn (D:/aplikacje/nRF/v2.6.0/modules/lib/cmsis-nn)"
osource "$(ZEPHYR_CMSIS_NN_KCONFIG)"
config ZEPHYR_CMSIS_NN_MODULE
	bool
	default y
endmenu
menu "fatfs (D:/aplikacje/nRF/v2.6.0/modules/fs/fatfs)"
osource "$(ZEPHYR_FATFS_KCONFIG)"
config ZEPHYR_FATFS_MODULE
	bool
	default y
endmenu
menu "hal_nordic (D:/aplikacje/nRF/v2.6.0/modules/hal/nordic)"
osource "$(ZEPHYR_HAL_NORDIC_KCONFIG)"
config ZEPHYR_HAL_NORDIC_MODULE
	bool
	default y
endmenu
config ZEPHYR_ST_MODULE
   bool
   default y
config ZEPHYR_HAL_WURTHELEKTRONIK_MODULE
   bool
   default y
config ZEPHYR_LIBMETAL_MODULE
   bool
   default y
menu "liblc3 (D:/aplikacje/nRF/v2.6.0/modules/lib/liblc3)"
osource "$(ZEPHYR_LIBLC3_KCONFIG)"
config ZEPHYR_LIBLC3_MODULE
	bool
	default y
endmenu
menu "littlefs (D:/aplikacje/nRF/v2.6.0/modules/fs/littlefs)"
osource "$(ZEPHYR_LITTLEFS_KCONFIG)"
config ZEPHYR_LITTLEFS_MODULE
	bool
	default y
endmenu
menu "loramac-node (D:/aplikacje/nRF/v2.6.0/modules/lib/loramac-node)"
osource "$(ZEPHYR_LORAMAC_NODE_KCONFIG)"
config ZEPHYR_LORAMAC_NODE_MODULE
	bool
	default y
endmenu
menu "lvgl (D:/aplikacje/nRF/v2.6.0/modules/lib/gui/lvgl)"
osource "D:/aplikacje/nRF/v2.6.0/modules/lib/gui/lvgl/Kconfig"
config ZEPHYR_LVGL_MODULE
	bool
	default y
endmenu
config ZEPHYR_MIPI_SYS_T_MODULE
   bool
   default y
config ZEPHYR_NRF_HW_MODELS_MODULE
   bool
   default y
config ZEPHYR_OPEN_AMP_MODULE
   bool
   default y
menu "picolibc (D:/aplikacje/nRF/v2.6.0/modules/lib/picolibc)"
osource "D:/aplikacje/nRF/v2.6.0/modules/lib/picolibc/zephyr/Kconfig"
config ZEPHYR_PICOLIBC_MODULE
	bool
	default y
endmenu
menu "segger (D:/aplikacje/nRF/v2.6.0/modules/debug/segger)"
osource "$(ZEPHYR_SEGGER_KCONFIG)"
config ZEPHYR_SEGGER_MODULE
	bool
	default y
endmenu
config ZEPHYR_TINYCRYPT_MODULE
   bool
   default y
menu "uoscore-uedhoc (D:/aplikacje/nRF/v2.6.0/modules/lib/uoscore-uedhoc)"
osource "$(ZEPHYR_UOSCORE_UEDHOC_KCONFIG)"
config ZEPHYR_UOSCORE_UEDHOC_MODULE
	bool
	default y
endmenu
menu "zcbor (D:/aplikacje/nRF/v2.6.0/modules/lib/zcbor)"
osource "$(ZEPHYR_ZCBOR_KCONFIG)"
config ZEPHYR_ZCBOR_MODULE
	bool
	default y
endmenu
menu "nrfxlib (D:/aplikacje/nRF/v2.6.0/nrfxlib)"
osource "D:/aplikacje/nRF/v2.6.0/nrfxlib/Kconfig.nrfxlib"
config ZEPHYR_NRFXLIB_MODULE
	bool
	default y
endmenu
menu "connectedhomeip (D:/aplikacje/nRF/v2.6.0/modules/lib/matter)"
osource "D:/aplikacje/nRF/v2.6.0/modules/lib/matter/config/nrfconnect/chip-module/Kconfig"
config ZEPHYR_CONNECTEDHOMEIP_MODULE
	bool
	default y
endmenu
```

## SOFTWARE/e-paper/build_1/Kconfig/Kconfig.sysbuild.modules
```kconfig
menu "nrf (D:/aplikacje/nRF/v2.6.0/nrf)"
osource "D:/aplikacje/nRF/v2.6.0/nrf/sysbuild/Kconfig.sysbuild"
config ZEPHYR_NRF_MODULE
	bool
	default y
endmenu
```
